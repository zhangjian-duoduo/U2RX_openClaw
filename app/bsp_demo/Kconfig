## kernel/src/Kconfig
```kconfig
menu "RT-Thread Kernel"
config RT_NAME_MAX
    int "The maximal size of kernel object name"
    range 2 32
    default 16
    help
        Each kernel object, such as thread, timer, semaphore etc, has a name,
        the RT_NAME_MAX is the maximal size of this object name.

config RT_USING_SMP
    bool "Enable SMP(Symmetric multiprocessing)"
    default n
    help
        This option should be selected by machines which have an SMP-
        capable CPU.
        The only effect of this option is to make the SMP-related
        options available to the user for configuration.

config RT_CPUS_NR
    int "Number of CPUs"
    default 2
    depends on RT_USING_SMP
    help
        Number of CPUs in the system

config RT_ALIGN_SIZE
    int "Alignment size for CPU architecture data access"
    default 4
    help
        Alignment size for CPU architecture data access

    choice
        prompt "The maximal level value of priority of thread"
        default RT_THREAD_PRIORITY_256

        config RT_THREAD_PRIORITY_8
            bool "8"

        config RT_THREAD_PRIORITY_32
            bool "32"

        config RT_THREAD_PRIORITY_256
            bool "256"
    endchoice

config RT_THREAD_PRIORITY_MAX
    int
    default 8   if RT_THREAD_PRIORITY_8
    default 32  if RT_THREAD_PRIORITY_32
    default 256 if RT_THREAD_PRIORITY_256

config RT_TICK_PER_SECOND
    int "Tick frequency, Hz"
    range 10 1000
    default 100
    help
        System's tick frequency, Hz.

config MAX_HANDLERS
    int "Interrupt Descriptor Number"
    range 256 2048
    help
        Used interrupt descriptor number

config RT_USING_VFP
    bool "vfp"
    default y

config RT_USING_HOOK
    bool "Enable system hook"
    default y
    select RT_USING_IDLE_HOOK
    help
        Enable the hook function when system running, such as idle thread hook,
        thread context switch etc.

config RT_USING_IDLE_HOOK
    bool "Enable IDLE Task hook"
    default y if RT_USING_HOOK

    if RT_USING_IDLE_HOOK
    config RT_IDEL_HOOK_LIST_SIZE
        int "The max size of idel hook list"
        default 4
        range 1 16
        help
            The system has a hook list. This is the hook list size.
    endif

config IDLE_THREAD_STACK_SIZE
    int "The stack size of idle thread"
    default 1024

config RT_USING_CPU_IDLE
    bool "Use cpu idle function when idle"
    default n
    help
        Use cpu idle function when idle
        now only armv6 supportted by WFI

config RT_USING_TIMER_SOFT
    bool "Enable software timer with a timer thread"
    default y
    help
        the timeout function context of soft-timer is under a high priority timer
        thread.

if RT_USING_TIMER_SOFT
config RT_TIMER_THREAD_PRIO
    int "The priority level value of timer thread"
    default 8

config RT_TIMER_THREAD_STACK_SIZE
    int "The stack size of timer thread"
    default 2048

endif

config USER_INIT_THREAD_STACK_SIZE
    int "The stack size of user main thread"
    default 32768

menuconfig RT_DEBUG
    bool "Enable debugging features"
    default y

if RT_DEBUG

config RT_DEBUG_COLOR
    bool "Enable color debugging log"
    default y


menuconfig RT_RUNLOG
    bool "Runlog debugging (Fullhan)"
    default n
    help
      If you say Y here, the /proc/runlog file will be provided
      that can help debug the scheduler/irq/sirq etc.

if RT_RUNLOG
config RT_RUNLOG_SIZE_KB
    int "Runlog size in KB"
    default 64

config RT_RUNLOG_USE_CUSTOM_MEM
    bool "Use custom memory"
    help
      Configure RT_RUNLOG_CUSTOM_MEM_ADDR used by runlog

if RT_RUNLOG_USE_CUSTOM_MEM
config RT_RUNLOG_CUSTOM_MEM_ADDR
    hex "Custom memory address"
endif

config RT_RUNLOG_COHERENT_MEM
    bool "Use coherent mem (noncached)"
    default n

config RT_RUNLOG_MEM_PERCPU
    bool "Separate memory for each cpu"
    help
      If you say Y here, total runlog size is RT_RUNLOG_SIZE_KB * NR_CPUS
    default n

config RT_RUNLOG_TRACE_SCHED
    bool "Sched trace enable"
    default y

if RT_RUNLOG_TRACE_SCHED
config SCHED_RUNTIME_WARN_US
    int "Sched warn runtime (us) (0:disable)"
    default 0
    help
      if a task runtime > SCHED_RUNTIME_WARN_US, print task info to
      console, set a zero value to disable this feature, also can be set by
      `runlog warn xxx`
endif

config RT_RUNLOG_TRACE_IRQ
    bool "IRQ trace enable"
    default y

config RT_RUNLOG_TRACE_WHEN_STARTUP
    bool "Enable runlog trace when startup"
    default y
    help
      enable when startup, if choose n, you can also run
      'runlog 0/1' to start/stop runlog
endif

config RT_USING_BACKTRACE
    bool "Enable backtrace"
    default n
    help
        Enable backtrace.

if RT_USING_SLAB
    config RT_USING_MM_TRACE
    bool "Enable memory management trace function"
endif

config RT_USING_OVERFLOW_CHECK
    bool "Using stack overflow checking"
    default y
    help
        Enable thread stack overflow checking. The stack overflow is checking when
        each thread switch.

config RT_DEBUG_INIT_CONFIG
    bool "Enable debugging of components initialization"
    default n

config RT_DEBUG_INIT
    int
    default 1 if RT_DEBUG_INIT_CONFIG

config RT_DEBUG_THREAD_CONFIG
    bool "Enable debugging of Thread State Changes"
    default n

config RT_DEBUG_THREAD
    int
    default 1 if RT_DEBUG_THREAD_CONFIG

config RT_DEBUG_SCHEDULER_CONFIG
    bool "Enable debugging of Scheduler"
    default n

config RT_DEBUG_SCHEDULER
    int
    default 1 if RT_DEBUG_SCHEDULER_CONFIG

config RT_DEBUG_IPC_CONFIG
    bool "Enable debugging of IPC"
    default n

config RT_DEBUG_IPC
    int
    default 1 if RT_DEBUG_IPC_CONFIG

config RT_DEBUG_TIMER_CONFIG
    bool "Enable debugging of Timer"
    default n

config RT_DEBUG_TIMER
    int
    default 1 if RT_DEBUG_TIMER_CONFIG

config RT_DEBUG_IRQ_CONFIG
    bool "Enable debugging of IRQ(Interrupt Request)"
    default n

config RT_DEBUG_IRQ
    int
    default 1 if RT_DEBUG_IRQ_CONFIG

config RT_DEBUG_MEM_CONFIG
    bool "Enable debugging of Small Memory Algorithm"
    default n

config RT_DEBUG_MEM
    int
    default 1 if RT_DEBUG_MEM_CONFIG

config RT_DEBUG_SLAB_CONFIG
    bool "Enable debugging of SLAB Memory Algorithm"
    default n

config RT_DEBUG_SLAB
    int
    default 1 if RT_DEBUG_SLAB_CONFIG

config RT_DEBUG_MEMHEAP_CONFIG
    bool "Enable debugging of Memory Heap Algorithm"
    default n

config RT_DEBUG_MEMHEAP
    int
    default 1 if RT_DEBUG_MEMHEAP_CONFIG

config RT_DEBUG_MODULE_CONFIG
    bool "Enable debugging of Application Module"
    default n

config RT_DEBUG_MODULE
    int
    default 1 if RT_DEBUG_MODULE_CONFIG

config RT_DETECT_INFINITE_LOOP
    bool "Detect Infinite Loop"
    select RT_USING_HOOK
    default n
    help
        Detect Infinite Loop Thread, print error message if detected.

config RT_INFINITE_LOOP_THRESHOLD
    int "Infinite loop detect threshold value"
    default 200
    range 32 32768
    depends on RT_DETECT_INFINITE_LOOP
    help
        Infinite loop detect threshold value, a thread runs longer than this
        threshold value will be detected as in infinite loop.

endif

menu "Inter-Thread communication"

config RT_USING_SEMAPHORE
    bool "Enable semaphore"
    default y

config RT_USING_MUTEX
    bool "Enable mutex"
    default y

config RT_USING_EVENT
    bool "Enable event flag"
    default y

config RT_USING_MAILBOX
    bool "Enable mailbox"
    default y

config RT_USING_MESSAGEQUEUE
    bool "Enable message queue"
    default y

config RT_USING_SIGNALS
    # NOT support signals, disable it!!!
    bool # "Enable signals"
    select RT_USING_MEMPOOL
    default n
    help
        A signal is an asynchronous notification sent to a specific thread
        in order to notify it of an event that occurred.

config RT_USING_THREAD_LOCK
    bool "Enable thread level lock"
    depends on RT_USING_SEMAPHORE
    default y
endmenu

menu "Memory Management"

    config RT_USING_MEMPOOL
        bool "Using memory pool"
        default y
        help
            Using static memory fixed partition

    config RT_USING_MEMHEAP
        bool "Using memory heap object"
        default y
        help
            Using memory heap object to manage dynamic memory heap.

    choice
        prompt "Dynamic Memory Management"
        default RT_USING_SLAB

        config RT_USING_NOHEAP
            bool "Disable Heap"

        config RT_USING_SMALL_MEM
            bool "Small Memory Algorithm"

        config RT_USING_SLAB
            bool "SLAB Algorithm for large memory"

        if RT_USING_MEMHEAP
        config RT_USING_MEMHEAP_AS_HEAP
            bool "Use all of memheap objects as heap"
        endif
    endchoice

    if RT_USING_SMALL_MEM
        config RT_USING_MEMTRACE
            bool "Enable memory trace"
            default n
            help
                When enable RT_USING_MEMTRACE with shell, developer can call cmd:
                1. memtrace
                   to dump memory block information.
                2. memcheck
                   to check memory block to avoid memory overwritten.

                And developer also can call memcheck() in each of scheduling
                to check memory block to find which thread has wrongly modified
                memory.
    endif

    config RT_USING_HEAP
        bool
        default n if RT_USING_NOHEAP
        default y if RT_USING_SMALL_MEM
        default y if RT_USING_SLAB
        default y if RT_USING_MEMHEAP_AS_HEAP

endmenu

menu "Kernel Device Object"

    config RT_USING_DEVICE
        bool "Using device object"
        default y

    config RT_USING_DEVICE_OPS
        bool
        # bool "Using ops for each device object"
        # this OPTIONS makes kernel objects' size different, disable this OPTION!
        default n

    config RT_USING_INTERRUPT_INFO
        bool "Enable additional interrupt trace information"
        default y
        help
            Add name and counter information for interrupt trace.

    config RT_USING_CONSOLE
        bool "Using console for rt_kprintf"
        default y

    if RT_USING_CONSOLE
        config RT_CONSOLEBUF_SIZE
            int "the buffer size for console log printf"
            default 128

        config RT_CONSOLE_DEVICE_NAME
            string "the device name for console"
            default "uart0"
    endif

endmenu

config RT_VER_NUM
    hex
    default 0x30103
    help
        RT-Thread version number

endmenu
```

## net/Kconfig.new
```kconfig
menu "Network configuration"

config RT_USING_LWIP
    bool "Enable LwIP v2.1.2"
    default y

config RT_USING_LWIP_IPV6
    bool "Enable IPv6 support"
    depends on RT_USING_LWIP
    default y

endmenu
```

## platform/Kconfig
```kconfig
config SDKROOT
    string
    option env="SDKROOT"

menu "Platform Configuration"

config RT_USING_CALIBRATE
    bool

config CONFIG_ARCH_FULLHAN
    bool
    select RT_USING_TIMER_SOFT
    select RT_USING_GPIO
    select RT_USING_CALIBRATE

config CONFIG_ARCH_FH8862
    bool
    default n
    select ARCH_ARM_CORTEX_A7
    select CONFIG_ARCH_FULLHAN

config CONFIG_ARCH_MC632X
    bool
    default n
    select ARCH_ARM_CORTEX_A7
    select CONFIG_ARCH_FULLHAN

config CONFIG_ARCH_FH885xV500
    bool
    default n
    select ARCH_ARM_CORTEX_A7
    select CONFIG_ARCH_FULLHAN

config CONFIG_ARCH_FH8626V300
    bool
    default n
    select ARCH_ARM_ARM11
    select CONFIG_ARCH_FULLHAN

config FH_USING_AON_PIN
    bool
    depends on CONFIG_ARCH_FH8626V300
    default y

choice
    prompt "Choose chip"
    default CONFIG_CHIP_FH8626V300

config CONFIG_CHIP_FH8862
    bool "FH8862"
    select CONFIG_ARCH_FH8862

config CONFIG_CHIP_MC632X
    bool "MC632X"
    select CONFIG_ARCH_MC632X

config CONFIG_CHIP_FH8856V500
    bool "FH8856V500"
    select CONFIG_ARCH_FH885xV500

config CONFIG_CHIP_FH8857V500
    bool "FH8857V500"
    select CONFIG_ARCH_FH885xV500

config CONFIG_CHIP_FH8626V300
    bool "FH8626V300"
    select CONFIG_ARCH_FH8626V300

endchoice

config FH_USING_VMM
    bool "arm enable vmm"
    depends on APP_CONFIG_MEDIA_DEMO
    default n

config FH_USING_DDRBOOT
    bool "boot arc using ddrboot"
    depends on APP_CONFIG_RPC_VIDEO
    default n

if !FH_USING_DDRBOOT
    config FH_USING_LOAD_NBG
        bool "enable arm load nbg file"
        depends on APP_CONFIG_RPC_VIDEO
        default n
endif

config FH_USING_PSRAM
    bool "enable psram"
    default n

config FH_FAST_BOOT
    bool "arm boot fast"
    default n

choice
    prompt "Choose board"
    default CONFIG_BOARD_APP

config CONFIG_BOARD_APP
    bool "app board"

config CONFIG_BOARD_TEST
    bool "test board"

endchoice

# comment "Boot stages"
config FH_ENABLE_SELF_LOAD_CODE
    bool "boot in multi-stage"
    default y

if FH_ENABLE_SELF_LOAD_CODE
    choice
        prompt "Choose compress method"
        depends on FH_ENABLE_SELF_LOAD_CODE
        default FH_CONFIG_COMPRESS_LZO

        config FH_CONFIG_COMPRESS_LZO
            bool "LZO"
            depends on FH_USING_LZOP
            help
                fastest decompression, for fastboot

        config FH_CONFIG_COMPRESS_GZIP
            bool "GZIP"
            depends on FH_USING_ZLIB
            help
                balance for decompression speed and compress ratio

        config FH_CONFIG_COMPRESS_LZMA
            bool "LZMA"
            depends on FH_USING_LZMA
            help
                best compression, use least flash storage space.
    endchoice

endif

source "$SDKROOT/platform/cpu/Kconfig"

endmenu
```

## shell/Kconfig
```kconfig
menu "Command shell"

config RT_USING_FINSH
    bool "enable shell"
    default y

if RT_USING_FINSH

config FINSH_THREAD_NAME
    string "The shell thread name"
    default "tshell"
config FINSH_USING_HISTORY
    bool "Enable command history feature"
    default y
if FINSH_USING_HISTORY
config FINSH_HISTORY_LINES
    int "The command history line number"
    default 20
endif

config FINSH_USING_SYMTAB
    bool "Using symbol table for commands"
    default y

config FINSH_USING_DESCRIPTION
    bool "Keeping description in symbol table"
    default y

config FINSH_ECHO_DISABLE_DEFAULT
    bool "Disable the echo mode in default"
    default n

config FINSH_THREAD_PRIORITY
    int "The priority level value of shell thread"
    default 20

config FINSH_THREAD_STACK_SIZE
    int "The stack size for shell thread"
    default 15360

config FINSH_CMD_SIZE
    int "The command line size for shell"
    default 256

config FINSH_USING_AUTH
    bool "shell support authentication"
    default n

if FINSH_USING_AUTH
config FINSH_DEFAULT_PASSWORD
    string "The default password for shell authentication"
    default "rtthread"
config FINSH_PASSWORD_MIN
    int "The password min length"
    default 6
config FINSH_PASSWORD_MAX
    int "The password max length"
    default RT_NAME_MAX
endif

config FINSH_USING_MSH
    # bool
    bool "Using module shell"
    default y

if FINSH_USING_MSH
config FINSH_USING_MSH_DEFAULT
    # bool
    bool "Using module shell in default"
    default y

config FINSH_USING_MSH_ONLY
    # bool
    bool "Only using module shell"
    default y

config FINSH_ARG_MAX
    int "The command arg num for shell"
    default 32
endif

endif

endmenu
```
